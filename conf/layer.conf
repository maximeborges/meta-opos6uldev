## conf/layer.conf
```bitbake
# We have a conf and classes directory, add to BBPATH
BBPATH .= ":${LAYERDIR}"

# We have a packages directory, add to BBFILES
BBFILES += "${LAYERDIR}/recipes-*/*/*.bb \
            ${LAYERDIR}/recipes-*/*/*.bbappend"

BBFILE_COLLECTIONS += "opos6uldev"
BBFILE_PATTERN_opos6uldev := "^${LAYERDIR}/"
BBFILE_PRIORITY_opos6uldev = "4"

LAYERSERIES_COMPAT_opos6uldev = "sumo"
LAYERDEPENDS_opos6uldev = "core freescale-layer"
```

## conf/machine/imx6ul-imx6ull-opos6uldev.conf
```bitbake
#@TYPE: Machine
#@NAME: IMX6UL-IMX6ULL-OPOS6ULDEV
#@SOC: i.MX6UL
#@DESCRIPTION: Machine configuration for IMX6UL(L)-OPOS6ULDEV board.
#@MAINTAINER: Maxime Borges <maxime.borges@strataggem.com>

MACHINEOVERRIDES =. "mx6:mx6ul:mx6ull"

include conf/machine/include/imx-base.inc
include conf/machine/include/tune-cortexa7.inc

MACHINE_FEATURES += "wifi usbhost bluetooth"

SERIAL_CONSOLE = "115200 ttymxc0"

PREFERRED_PROVIDER_virtual/kernel ?= "linux-fslc"
KERNEL_DEVICETREE = "imx6ul-opos6uldev.dtb imx6ull-opos6uldev.dtb"
KERNEL_IMAGETYPE = "zImage"
INITRAMFS_FSTYPES = "cpio.gz.u-boot"

# Don't integrate the u-boot image in the WIC file since it should be flashed
# on a separate hard partition on the eMMC
IMAGE_BOOTLOADER ?= ""
EXTRA_IMAGEDEPENDS += "u-boot"

UBOOT_MAKE_TARGET = "all"
UBOOT_SUFFIX = "img"
UBOOT_MACHINE = "opos6uldev_defconfig"
SPL_BINARY = "SPL"

MACHINE_ESSENTIAL_EXTRA_RDEPENDS += " \
    kernel-image \
    kernel-devicetree \
    kernel-modules \
    u-boot-fslc \
    linux-firmware-bcm43430 \
    linux-firmware-bcm43430-config \
    kernel-module-brcmfmac \
"
KERNEL_MODULE_AUTOLOAD += "brcmfmac"

IMAGE_FSTYPES = "wic"
```
